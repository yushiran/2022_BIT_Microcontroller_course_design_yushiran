/* 按钮　关应用(两按钮控制七段显示器上下数) - P4-21 */
//==声明区==========================================
#include	<reg51.h>	//	定义8051暂存器的标头档,P2-17~19 
#define	SEG	P0			//	定义七节显示器接至Port 0
/* 声明七节显示器驱动信号阵列(共阳) */
char code TAB[10]={	0xc0, 0xf9, 0xa4, 0xb0, 0x99,	// 数字0-4
			  	 	0x92, 0x83, 0xf8, 0x80, 0x98 };	// 数字5-9
sbit  PB1=P2^0;			//	声明按钮1接至P2.0
sbit  PB2=P2^1;			//	声明按钮2接至P2.1
void debouncer(void);	//	声明防弹跳函数 
//==主程式=================================
main()					// 主程序开始 
{	unsigned char i=0;	//	声明变量i初值=0 
	PB1=PB2=1;			//	规划输入端口 
	SEG=TAB[i];			//	输出数字至七段显示器 
	while(1)			//	无穷循环,程式一直跑 
	{	if (PB1==0)		//	判断PB1是否按下 
		{	debouncer();//	呼叫防弹跳函数 
			i= (i<9)? i+1:0;//	若i<9则i=i+1，若i>=9清除为0
			SEG=TAB[i];	//	输出数字至七段显示器 
			while(PB1==0);	//	PB1是否按住？ 
			debouncer();	//	呼叫防弹跳函数 
		}				//	if叙述结束 
		if (PB2==0)		//	判断PB2是否按下	 
		{	debouncer();//	呼叫防弹跳函数 
			i= (i>0)? i-1:9;//	若i>0则i=i-1，i<=0重设为9
			SEG=TAB[i];	//	输出数字至七段显示器 
			while(PB2==0);	//	PB1是否按住？ 
			debouncer();	//	呼叫防弹跳函数 
		}				//	if叙述结束 
	}					//	while循环结束   
}						//	主程序结束 
//==子程序==================================
/* 防弹跳函数函数,延迟约20ms */
void debouncer(void)	//	防弹跳函数开始 
{	int i;				//	声明整数变量i 
	for(i=0;i<2400;i++);	//	计数2400次,延迟约20ms 
}						//	防弹跳函数结束 
